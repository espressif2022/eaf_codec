## Kconfig
```kconfig
menu "ESP EAF Codec & Player Configuration"

    config ESP_LV_EAF_ENABLE_SW_JPEG
        bool "Enable Software JPEG Decoder (esp_new_jpeg) for 0x02/0x06 modes"
        default y
        help
            Enable software JPEG decoding fallback for 0x02 JPEG_KEYFRAME and
            0x06 QUAD_JPEG modes. Disable to save ~19KB DRAM if only using
            0x04 LOSSLESS or 0x05 BTC_SAFE modes.

    config ESP_LV_EAF_ENABLE_HW_JPEG
        bool "Enable Hardware JPEG 2D-DMA Acceleration (ESP32-P4 / ESP32-S31)"
        default y
        depends on SOC_JPEG_DECODE_SUPPORTED
        help
            Use the hardware JPEG 2D-DMA engine when image/strip dimensions align
            with the hardware horizontal macroblock burst size (hb = 32 / 48).

endmenu
```

## bench/s31_firmware/sdkconfig.defaults
```kconfig
CONFIG_IDF_TARGET="esp32s31"
CONFIG_ESPTOOLPY_FLASHSIZE_8MB=y
CONFIG_PARTITION_TABLE_CUSTOM=y
CONFIG_PARTITION_TABLE_CUSTOM_FILENAME="partitions.csv"
CONFIG_COMPILER_OPTIMIZATION_PERF=y
CONFIG_SPIRAM=y
CONFIG_SPIRAM_SPEED_250M=y
CONFIG_SPIRAM_XIP_FROM_PSRAM=y
CONFIG_SPIRAM_MEMTEST=n
CONFIG_SPIRAM_MALLOC_ALWAYSINTERNAL=0
CONFIG_ESP_MAIN_TASK_STACK_SIZE=16384
CONFIG_FREERTOS_HZ=1000
CONFIG_ESP_DEFAULT_CPU_FREQ_MHZ_320=y
```

## components/esp_lv_eaf_player/Kconfig
```kconfig
menu "ESP LV EAF Player"

    config ESP_LV_EAF_ENABLE_SW_JPEG
        bool "Enable Software JPEG Decoding"
        default y
        help
            Enable software JPEG decoder for EAF files with JPEG-encoded blocks.
            Disabling this option saves ~19KB DRAM but JPEG blocks will fail to
            decode with a runtime warning.

            You can disable this when all assets use Palette RLE/Huffman,
            Lossless, Bounded, or H.264 and contain no JPEG/JPEG Delta blocks.

endmenu
```

## components/esp_lv_eaf_player/test_apps/core/sdkconfig.defaults
```kconfig
CONFIG_IDF_TARGET="esp32s3"
CONFIG_ESP_MAIN_TASK_STACK_SIZE=8192
CONFIG_ESP_TASK_WDT_EN=n
```
